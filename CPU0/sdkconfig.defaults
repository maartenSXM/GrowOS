## CPU0/sdkconfig.defaults
```kconfig
CONFIG_AUTOSTART_ARDUINO=y
# CONFIG_BOOTLOADER_WDT_ENABLE is not set
CONFIG_ESPTOOLPY_FLASHFREQ_40M=y
CONFIG_ESPTOOLPY_FLASHSIZE_4MB=y
CONFIG_ESP32S2_RTC_CLK_SRC_EXT_CRYS=y
CONFIG_ESP32S2_RTC_CLK_CAL_CYCLES=576
CONFIG_ESP_SLEEP_POWER_DOWN_FLASH=y
CONFIG_FREERTOS_HZ=1000
CONFIG_TFT_ILI9488_DRIVER=y
CONFIG_TFT_MISO=37
CONFIG_TFT_MOSI=35
CONFIG_TFT_SCLK=36
CONFIG_TFT_SPI_FREQUENCY=20000000
CONFIG_TFT_SPI_READ_FREQ=5000000
CONFIG_TFT_CS=33
CONFIG_TFT_DC=34
CONFIG_TFT_RST=7
CONFIG_TFT_BL=21
```

## cpu1/sdkconfig.defaults
```kconfig
# CONFIG_BOOTLOADER_WDT_ENABLE is not set
CONFIG_ESPTOOLPY_FLASHFREQ_40M=y
CONFIG_ESPTOOLPY_FLASHSIZE_4MB=y
CONFIG_ESP_SLEEP_POWER_DOWN_FLASH=y
CONFIG_FREERTOS_HZ=1000
```

## sdkconfig.defaults
```kconfig
CONFIG_AUTOSTART_ARDUINO=y
CONFIG_BOOTLOADER_WDT_ENABLE=n
CONFIG_ENABLE_BL=y
CONFIG_ESP32S2_RTC_CLK_CAL_CYCLES=576
CONFIG_ESP32S2_RTC_CLK_SRC_EXT_CRYS=y
CONFIG_ESP32S2_RTC_XTAL_CAL_RETRY=3
CONFIG_ESPTOOLPY_FLASHFREQ="40m"
CONFIG_ESPTOOLPY_FLASHFREQ_40M=y
CONFIG_ESPTOOLPY_FLASHSIZE="4MB"
CONFIG_ESPTOOLPY_FLASHSIZE_4MB=y
CONFIG_ESP_INT_WDT=y
CONFIG_ESP_INT_WDT_TIMEOUT_MS=300
CONFIG_ESP_SLEEP_FLASH_LEAKAGE_WORKAROUND=y
CONFIG_ESP_SLEEP_GPIO_ENABLE_INTERNAL_RESISTORS=y
CONFIG_ESP_SLEEP_POWER_DOWN_FLASH=y
CONFIG_ESP_SYSTEM_RTC_EXT_XTAL=y
CONFIG_ESP_SYSTEM_RTC_EXT_XTAL_BOOTSTRAP_CYCLES=0
CONFIG_ESP_SYSTEM_RTC_XTAL_BOOTSTRAP_CYCLES=0
CONFIG_ESP_TASK_WDT=y
CONFIG_ESP_TASK_WDT_CHECK_IDLE_TASK_CPU0=y
CONFIG_ESP_TASK_WDT_TIMEOUT_S=5
CONFIG_FREERTOS_HZ=1000
CONFIG_LWIP_TCPIP_TASK_PRIO=18
CONFIG_TFT_BL=21
CONFIG_TFT_CS=33
CONFIG_TFT_DC=34
CONFIG_TFT_ILI9488_DRIVER=y
CONFIG_TFT_MISO=37
CONFIG_TFT_MOSI=35
CONFIG_TFT_RST=7
CONFIG_TFT_SCLK=36
CONFIG_TFT_SPI=y
CONFIG_TFT_SPI_FREQUENCY=20000000
CONFIG_TFT_SPI_READ_FREQ=5000000
```
